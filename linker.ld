ENTRY(_start)

SECTIONS
{
	. = 0xC0000000;

	.text BLOCK(4K) : ALIGN(4K)
	{
		*(.text)
	}

	.rodata BLOCK(4K) : ALIGN(4K)
	{
		*(.rodata)
	}

	.data BLOCK(4K) : ALIGN(4K)
	{
		*(.data)
	}

	.bss BLOCK(4K) : ALIGN(4K)
	{
		*(COMMON)
		*(.bss)
	}

	.tbss BLOCK(4K) : ALIGN(4K)
	{
		*(.tbss)
	}
}
